## arch/lib/Kconfig
```kconfig
mainmenu "Linux Library OS (libos) $KERNELVERSION Configuration"

config LIB
       def_bool y
       select PROC_FS
       select PROC_SYSCTL
       select SYSCTL
       select SYSFS
       help
          The 'lib' architecture is a library (user-mode) version of
          the linux kernel that includes only its network stack and is
	  used within the userspace application, and ns-3 simulator.
	  For more information, about ns-3, see http://www.nsnam.org.

config ARCH
	string
	default $(ARCH)

config KERNELVERSION
	string
	default $(KERNELVERSION)

config MODULES
	def_bool y
	option modules

config MMU
        def_bool n

config FPU
        def_bool n

config SMP
        def_bool n

config GENERIC_CSUM
	def_bool y

config GENERIC_BUG
	def_bool y
	depends on BUG

config PRINTK
       def_bool y

config RWSEM_GENERIC_SPINLOCK
	def_bool y

config GENERIC_HWEIGHT
       def_bool y

config TRACE_IRQFLAGS_SUPPORT
	def_bool y

config NO_HZ
	def_bool y

config BASE_FULL
       def_bool n

config SELECT_MEMORY_MODEL
       def_bool n

config FLAT_NODE_MEM_MAP
       def_bool n

config PAGEFLAGS_EXTENDED
       def_bool n

config VIRT_TO_BUS
       def_bool n

config HAS_DMA
       def_bool n

config HZ
        int
        default 250

config TINY_RCU
       def_bool y

config HZ_250
       def_bool y

config BASE_SMALL
       int
       default 1

config SPLIT_PTLOCK_CPUS
       int
       default 1

config FLATMEM
       def_bool y

config SYSCTL
       def_bool y

config PROC_FS
       def_bool y

config SYSFS
       def_bool y

config PROC_SYSCTL
       def_bool y

config MULTIUSER
       def_bool n

config NETDEVICES
       def_bool y

source "net/Kconfig"

source "drivers/base/Kconfig"

source "crypto/Kconfig"

source "lib/Kconfig"

config SLIB
       def_bool y

config BPF
       def_bool y

config GENERIC_STRNCPY_FROM_USER
       def_bool y

config FS
       def_bool y

config KERNFS
       def_bool y

config SECURITY
       def_bool y

config LSM
       string
       default "yama,loadpin,safesetid,integrity"

config BUILD_SALT
	string "Build ID Salt-LibOs"
```

## arch/sim/Kconfig
```kconfig
config SIM
       bool
       default y
       select PROC_FS
       select PROC_SYSCTL
       select SYSCTL
       select SYSFS
       help
          The 'sim' architecture is a user-mode version of the linux
	  kernel that includes only its network stack and is used
	  within the ns-3 simulator. For more information, about ns-3, 
	  see http://www.nsnam.org.

config EXPERIMENTAL
	def_bool y

config MMU
        def_bool n
config FPU
        def_bool n
config SMP
        def_bool n

config ARCH
	string
	option env="ARCH"

config KTIME_SCALAR
       def_bool y

config MODULES
       def_bool y

config GENERIC_CSUM
	def_bool y

config GENERIC_BUG
	def_bool y
	depends on BUG
config PRINTK
       def_bool y

config RWSEM_GENERIC_SPINLOCK
	def_bool y

config GENERIC_FIND_NEXT_BIT
	def_bool y

config GENERIC_HWEIGHT
       def_bool y

config TRACE_IRQFLAGS_SUPPORT
	def_bool y

config NO_HZ
	def_bool y

config BASE_FULL
       def_bool n

config SELECT_MEMORY_MODEL
       def_bool n

config FLAT_NODE_MEM_MAP
       def_bool n

config PAGEFLAGS_EXTENDED
       def_bool n

config VIRT_TO_BUS
       def_bool n

config HAS_DMA
       def_bool n

config HZ
        int
        default 250

config TINY_RCU
       def_bool y

config HZ_250
       def_bool y

config BASE_SMALL
       int
       default 1

config SPLIT_PTLOCK_CPUS
       int
       default 1

config FLATMEM
       def_bool y

config SYSCTL
       def_bool y

config PROC_FS
       def_bool y

config SYSFS
       def_bool y

config PROC_SYSCTL
       def_bool y

source "net/Kconfig"

source "drivers/base/Kconfig"

source "crypto/Kconfig"

source "lib/Kconfig"
```
